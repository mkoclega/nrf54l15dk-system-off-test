## CMakeLists.txt
```
cmake_minimum_required(VERSION 3.20.0)
find_package(Zephyr REQUIRED HINTS $ENV{ZEPHYR_BASE})

project(test-sleep)

target_sources(app PRIVATE
    src/main.c
    src/system_pm.c
)
```

## prj.conf
```kconfig
# enable needed features
CONFIG_GPIO=y

# enable Power Management
CONFIG_PM_DEVICE=y
CONFIG_PM_DEVICE_RUNTIME=y

# enable System OFF mode and HW info access
CONFIG_POWEROFF=y
CONFIG_HWINFO=y

# disable features not needed
CONFIG_RESET_ON_FATAL_ERROR=n
CONFIG_CBPRINTF_FP_SUPPORT=n
CONFIG_TIMESLICING=n
CONFIG_DYNAMIC_INTERRUPTS=n
CONFIG_IRQ_OFFLOAD=n

# disable boot banners
CONFIG_NCS_BOOT_BANNER=n
CONFIG_BOOT_BANNER=n

# disable console and logging
CONFIG_SERIAL=n
CONFIG_PRINTK=n
CONFIG_CONSOLE=n
CONFIG_EARLY_CONSOLE=n
CONFIG_STDOUT_CONSOLE=n
CONFIG_UART_CONSOLE=n
CONFIG_LOG=n
CONFIG_LOG_BACKEND_UART=n
CONFIG_LOG_BACKEND_RTT=n
```

## uart_log.conf
```kconfig
# enable boot banners
CONFIG_NCS_BOOT_BANNER=y

# enable console and logging
CONFIG_SERIAL=y
CONFIG_PRINTK=y
CONFIG_CONSOLE=y
CONFIG_EARLY_CONSOLE=y
CONFIG_STDOUT_CONSOLE=y
CONFIG_UART_CONSOLE=y
CONFIG_UART_ASYNC_API=y
CONFIG_LOG=y
CONFIG_LOG_MODE_IMMEDIATE=y
CONFIG_LOG_BACKEND_UART=y
CONFIG_LOG_BACKEND_RTT=n
```

## src/main.c
```c
#include <zephyr/kernel.h>
#include <zephyr/device.h>
#include <zephyr/logging/log.h>
#include <zephyr/drivers/gpio.h>
#include <zephyr/drivers/hwinfo.h>

#include "system_pm.h"

LOG_MODULE_REGISTER(main);


#define SLEEP_TIME_MS 5000

static const struct gpio_dt_spec led0 = GPIO_DT_SPEC_GET(DT_ALIAS(led0), gpios);
static const struct gpio_dt_spec led1 = GPIO_DT_SPEC_GET(DT_ALIAS(led1), gpios);
static const struct gpio_dt_spec led2 = GPIO_DT_SPEC_GET(DT_ALIAS(led2), gpios);
static const struct gpio_dt_spec led3 = GPIO_DT_SPEC_GET(DT_ALIAS(led3), gpios);


static void flash_led(uint32_t reset_cause, bool wakeup)
{
	if (wakeup)
		gpio_pin_set_dt(&led0, 1);
	else if (reset_cause & RESET_PIN)
		gpio_pin_set_dt(&led2, 1);
	else if (reset_cause & RESET_DEBUG)
		gpio_pin_set_dt(&led3, 1);
	else if (reset_cause == 0)
		gpio_pin_set_dt(&led1, 1);

	k_msleep(200);

    if (wakeup)
		gpio_pin_set_dt(&led0, 0);
	else if (reset_cause & RESET_PIN)
		gpio_pin_set_dt(&led2, 0);
	else if (reset_cause & RESET_DEBUG)
		gpio_pin_set_dt(&led3, 0);
	else if (reset_cause == 0)
		gpio_pin_set_dt(&led1, 0);
}

static int config_hw()
{
	if (!gpio_is_ready_dt(&led0) ||
		!gpio_is_ready_dt(&led1) ||
		!gpio_is_ready_dt(&led2) ||
		!gpio_is_ready_dt(&led3))
	{
		return -1;
	}

	int err;
	err = gpio_pin_configure_dt(&led0, GPIO_OUTPUT | GPIO_ACTIVE_HIGH);
	if (err != 0) return err;
	err = gpio_pin_configure_dt(&led1, GPIO_OUTPUT | GPIO_ACTIVE_HIGH);
	if (err != 0) return err;
	err = gpio_pin_configure_dt(&led2, GPIO_OUTPUT | GPIO_ACTIVE_HIGH);
	if (err != 0) return err;
	err = gpio_pin_configure_dt(&led3, GPIO_OUTPUT | GPIO_ACTIVE_HIGH);
	return err;
}

int main(void)
{
	// retrieve reset cause
	uint32_t reset_cause = 0;
	bool wakeup = false;
	system_pm_get_reset_cause(&reset_cause, &wakeup, NULL);

	if (config_hw() == 0)
	{
		flash_led(reset_cause, wakeup);
	}

	// System OFF
	return system_pm_system_off(SLEEP_TIME_MS);
}
```

## src/system_pm.c
```c
// System Power Management

#include <zephyr/devicetree.h>
#include <zephyr/pm/device.h>
#include <zephyr/sys/poweroff.h>
#include <zephyr/drivers/hwinfo.h>
#include <zephyr/drivers/timer/nrf_grtc_timer.h>
#include <zephyr/logging/log.h>
#include <helpers/nrfx_reset_reason.h>

#include "system_pm.h"

LOG_MODULE_REGISTER(system_pm);


#if defined(CONFIG_SERIAL) && DT_NODE_EXISTS(DT_CHOSEN(zephyr_console))

static const struct device *uart_dev = DEVICE_DT_GET(DT_CHOSEN(zephyr_console));

int uart_console_suspend()
{
    int err = pm_device_action_run(uart_dev, PM_DEVICE_ACTION_SUSPEND);
    if (err == 0)
    {
        enum pm_device_state state;
        do
        {
            err = pm_device_state_get(uart_dev, &state);
		} while (err == 0 && state != PM_DEVICE_STATE_SUSPENDED);
    }
    else
    {
        LOG_ERR("Could not suspend Console (err = %d).", err);
    }

    return err;
}

int uart_console_resume()
{
    int err = pm_device_action_run(uart_dev, PM_DEVICE_ACTION_RESUME);
    if (err == 0)
    {
        enum pm_device_state state;
        do
        {
            err = pm_device_state_get(uart_dev, &state);
		} while (err == 0 && state != PM_DEVICE_STATE_ACTIVE);
    }
    else
    {
        LOG_ERR("Could not resume Console (err = %d).", err);
    }

    return err;
}

#else // defined(CONFIG_SERIAL) && DT_NODE_EXISTS(DT_CHOSEN(zephyr_console))

int uart_console_suspend()
{
    return -ENOTSUP;
}

int uart_console_resume()
{
    return -ENOTSUP;
}

#endif // defined(CONFIG_SERIAL) && DT_NODE_EXISTS(DT_CHOSEN(zephyr_console))

int system_pm_get_reset_cause(uint32_t *p_reset_cause, bool *p_wakeup, bool *p_unexpected)
{
    bool wakeup = false;
    bool unexpected = false;
    uint32_t reset_cause = 0;
    int err = hwinfo_get_reset_cause(&reset_cause);
    if (err != 0)
    {
        k_msleep(2000);     //TODO: remove me
        LOG_ERR("Could not retrieve reset cause (err = %d).", err);
        return err;
    }

	if (reset_cause & RESET_POR)
    {
		LOG_INF("Power-on reset.");
	}
    else if (reset_cause & RESET_PIN)
    {
		LOG_INF("External pin reset.");
	}
    else if (reset_cause & RESET_WATCHDOG)
    {
        unexpected = true;
		LOG_WRN("Watchdog reset.");
	}
    else if (reset_cause & RESET_SOFTWARE)
    {
		LOG_INF("Software reset.");
	}
    else if (reset_cause & RESET_CPU_LOCKUP)
    {
        unexpected = true;
		LOG_WRN("CPU lock-up reset.");
	}
    else if (reset_cause & RESET_DEBUG)
    {
		LOG_INF("Debugger reset.");
	}
    else if (reset_cause & RESET_SECURITY)
    {
        unexpected = true;
		LOG_WRN("Tamper detect reset.");
	}
    else if (reset_cause & RESET_CLOCK)
    {
        wakeup = true;
		LOG_INF("Wake-up from System OFF by GRTC.");
	}
    else if (reset_cause & RESET_LOW_POWER_WAKE)
    {
        wakeup = true;
		LOG_INF("Wake-up from System OFF by DETECT/LPCOMP/NFC.");
	}
    else
    {
        uint32_t reset_cause_nrfx = nrfx_reset_reason_get();
        k_msleep(2000);     //TODO: remove me
        LOG_WRN("nrfx reset cause 0x%08X.", reset_cause_nrfx);

        unexpected = true;
		LOG_WRN("Other reset cause 0x%08X.", reset_cause);
	}

    if (p_reset_cause   != NULL) *p_reset_cause = reset_cause;
    if (p_wakeup        != NULL) *p_wakeup      = wakeup;
    if (p_unexpected    != NULL) *p_unexpected  = unexpected;

	return err;
}

int system_pm_system_off(uint32_t time_ms)
{
    int err = z_nrf_grtc_wakeup_prepare((uint64_t)time_ms * USEC_PER_MSEC);
    if (err == 0)
    {
        LOG_INF("Entering System OFF, wait %u ms for wake-up.", time_ms);
	}
    else
    {
		LOG_ERR("Unable to prepare GRTC as a wake-up source (err = %d).", err);
		return err;
	}

    uart_console_suspend();

    hwinfo_clear_reset_cause();
	sys_poweroff();

	// in fact, this function never returns
    return 0;
}
```

## src/system_pm.h
```c
// System Power Management

#ifndef SYSTEM_PM_H
#define SYSTEM_PM_H

#include <stdbool.h>
#include <stdint.h>


int system_pm_get_reset_cause(uint32_t *p_reset_cause, bool *p_wakeup, bool *p_unexpected);
int system_pm_system_off(uint32_t time_ms);


#endif // SYSTEM_PM_H
```
